/*
welcome use KeDeiTFT
*/
#include "KeDei_font.h"


//Word stock


/*****************************************
 *The function name ： begin
 *Function  ： 初始化类中的成员变量
 *Input  ： none
 *Output   ： none
 *Author   ：KeDei
 *Time   ：2015/4/21
 ****************************************/
void Font::begin(void)
{
		font_color		= 0xf800;
		font_interval = 2;
		font_leading = 6;
#if defined(USE_FONT_8_B)
		font_size = 8;
#else
		font_size = 16;
#endif
		txt_x0			= 0;
		txt_y0			= 0;
		txt_x1			= 240;
		txt_y1			= 320;

		now_x			= txt_x0;
		now_y			= txt_y0;
}

/*****************************************
 *The function name ： set_txt
 *Function  ： 设置文本区域，文本区域的左上坐标(x0,y0),右下坐标(x1,y1)，
			文本的颜色为txt_b_color；
			若txt_b_color为NULL 则不显示颜色，0x0000也一样的 ^.^
 *Input  ： none
 *Output   ： none
 *Author   ：KeDei
 *Time   ：2015/4/21
 ****************************************/
void Font::set_txt(unsigned short x0,unsigned short y0,unsigned short x1,unsigned short y1,unsigned short txt_b_color)
{
	txt_x0			= x0;
	txt_y0			= y0;
	txt_x1			= x1;
	txt_y1			= y1;
	now_x			= x0;
	now_y			= y0;
	txt_backcolor	= txt_b_color;
	//if(txt_b_color != NULL)
		TFT.draw_area(x0, y0, x1, y1, txt_b_color);
	
}

/*****************************************
 *The function name ： set_fontcolor
 *Function  ： 设置字体的颜色为f_color
 *Input  ： f_color
 *Output   ： none
 *Author   ：KeDei
 *Time   ：2015/4/21
 ****************************************/
void Font::set_fontcolor(unsigned short f_color)
{
	font_color	= f_color;
}


/*****************************************
 *The function name ： clear_txt
 *Function  ： 清楚当前的文本内容
 *Input  ： color  （no used）
 *Output   ： none
 *Author   ：KeDei
 *Time   ：2015/4/21
 ****************************************/
void Font::clear_txt(void)
{
	clear_txt(txt_backcolor);
}
void Font::clear_txt(unsigned short backColor)
{
	TFT.draw_area(txt_x0, txt_y0, txt_x1, txt_y1, backColor);
}


/*****************************************
 *The function name ： lcd_char
 *Function  ： 显示字符
 *Input  ： data
 *Output   ： none
 *Author   ： KeDei
 *Time   ： 2015/4/21
 ****************************************/
void Font::lcd_char(char _data)
{
#if defined(USE_FONT_8_B)
	// We also have found a smaller bitmap font table that
	// is about half the size of the original bitmap font table.
	// See https://github.com/dhepper/font8x8

#if defined(SMALLER_FONT_TABLE)
	static const unsigned char font_table[59][8] = {
#else
	static const unsigned char font_table[96][8] = {
#endif
		{ 0x00, 0x00, 0x00, 0x00, 0x00, 0x00, 0x00, 0x00 },   // U+0020 (space)
		{ 0x18, 0x3C, 0x3C, 0x18, 0x18, 0x00, 0x18, 0x00 },   // U+0021 (!)
		{ 0x36, 0x36, 0x00, 0x00, 0x00, 0x00, 0x00, 0x00 },   // U+0022 (")
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		{ 0x7F, 0x63, 0x31, 0x18, 0x4C, 0x66, 0x7F, 0x00 },   // U+005A (Z)
#if !defined(SMALLER_FONT_TABLE)
		// In the interest of reducing the memory requirements for the TFT library, we
		// allow for the use of a smaller font table which eliminates the lower case letters
		// as well as a few symbols. See below conversion of lower case letters to upper case.
		//    Richard Chambers, 04-25-2021
		{ 0x1E, 0x06, 0x06, 0x06, 0x06, 0x06, 0x1E, 0x00 },   // U+005B ([)
		{ 0x03, 0x06, 0x0C, 0x18, 0x30, 0x60, 0x40, 0x00 },   // U+005C (\)
		{ 0x1E, 0x18, 0x18, 0x18, 0x18, 0x18, 0x1E, 0x00 },   // U+005D (])
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		{ 0x6E, 0x3B, 0x00, 0x00, 0x00, 0x00, 0x00, 0x00 },   // U+007E (~)
#endif
	};
#else
#if defined(SMALLER_FONT_TABLE)
	static const unsigned char font_table[59][16] = {   // was font16_B
#else
	static const unsigned char font_table[95][16] = {   // was font16_B
#endif
			{0x00,0x00,0x00,0x00,0x00,0x00,0x00,0x00,0x00,0x00,0x00,0x00,0x00,0x00,0x00,0x00},/*" ",0*/
			{0x00,0x00,0x00,0x18,0x18,0x18,0x18,0x18,0x18,0x18,0x00,0x00,0x38,0x38,0x00,0x00},/*"!",1*/
			{0x00,0xD8,0xFC,0x6C,0x36,0x00,0x00,0x00,0x00,0x00,0x00,0x00,0x00,0x00,0x00,0x00},/*""",2*/
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			{0x00,0x00,0x00,0xFE,0x63,0x60,0x30,0x30,0x18,0x0C,0x0C,0xC6,0xC6,0x7F,0x00,0x00},/*"Z",58*/
#if !defined(SMALLER_FONT_TABLE)
			// In the interest of reducing the memory requirements for the TFT library, we
			// allow for the use of a smaller font table which eliminates the lower case letters
			// as well as a few symbols. See below conversion of lower case letters to upper case.
			//    Richard Chambers, 04-25-2021
			{0x00,0xF8,0x18,0x18,0x18,0x18,0x18,0x18,0x18,0x18,0x18,0x18,0x18,0x18,0xF8,0x00},/*"[",59*/
			{0x00,0x00,0x06,0x06,0x0C,0x0C,0x18,0x18,0x18,0x30,0x30,0x60,0x60,0x60,0xC0,0xC0},/*"\",60*/
			{0x00,0x3E,0x30,0x30,0x30,0x30,0x30,0x30,0x30,0x30,0x30,0x30,0x30,0x30,0x3E,0x00},/*"]",61*/
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			{0x1C,0x76,0xC6,0x00,0x00,0x00,0x00,0x00,0x00,0x00,0x00,0x00,0x00,0x00,0x00,0x00},/*"~",94*/
#endif
		};
#endif

	if(now_x > txt_x1 - (font_size / 2)) 
	{
		now_x =  txt_x0;
		now_y += font_size;
	}
	if(now_y > txt_y1 - font_size)
	{
		now_y = txt_y0;
		clear_txt(txt_backcolor);
	}

#if defined(SMALLER_FONT_TABLE)
	// Lets translate the character to one of the printable
	// characters in our font table. What we are doing is
	// to translate lower case letters to upper case letters
	// since in order to have a smaller font table taking up
	// less memory we remove the lower case letters.
	//    Richard Chambers, 04-25-2021
	if (_data < ' ' || _data > 'z') return;
	if (_data >= 'a') _data = _data - 'a' + 'A';
#endif
	unsigned char char_i = _data - ' ';

//Serial.println(char_i);
	for(unsigned char char_m = 0; char_m < font_size; char_m++)
	{
		for(unsigned char char_n = 0; char_n < 8; char_n++)
		{

			if (font_table[char_i][char_m] & 1 << char_n)
			{
			   TFT.set_area(now_x, now_y, ++now_x, now_y);
			   TFT.w_data(font_color >> 8);
			   TFT.w_data(font_color);
			}
			else
			{
			  now_x++;
  
			}
		 }
		 now_y++;
		 now_x -= 8;
	}
	now_y -= font_size;
	now_x += 8 + font_interval;
}

/*****************************************
 *The function name ： lcd_string
 *Function  ： 显示字符串
 *Input  ： *str
 *Output   ： none
 *Author   ： KeDei
 *Time   ： 2015/4/21
 ****************************************/
void Font::lcd_string(char str[])
{
  char *str_char=str;
  for(;;)
  {
      if(*str_char == '\0')
      {
          now_y += font_size + font_leading;
          now_x = txt_x0;
          return;
      }
      if(*str_char == '\n')
      {
          now_y += font_size + font_leading;
          now_x = txt_x0;
          str_char++ ;
      }
      lcd_char(*str_char++);
  }
}

/*****************************************
 *The function name ： lcd_int
 *Function  ： 显示整型变量值
 *Input  ： *int value
 *Output   ： none
 *Author   ： KeDei
 *Time   ： 2015/4/21
 ****************************************/
void	Font::lcd_int(int value)
{
	itoa(value,buff,10); 
	lcd_string(buff);
}